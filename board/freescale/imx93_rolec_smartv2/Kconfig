## board/freescale/imx93_rolec_smartv2/Kconfig
```kconfig
if TARGET_IMX93_11X11_ROLEC_SMARTV2

config SYS_BOARD
	default "imx93_rolec_smartv2"

config SYS_VENDOR
	default "freescale"

config SYS_CONFIG_NAME
	default "imx93_evk"

config IMX93_ROLEC_SMARTV2_LPDDR4X
	bool "Using LPDDR4X Timing and PMIC voltage"
	default y
	select IMX9_LPDDR4X
	help
	  Select the LPDDR4X timing and 0.6V VDDQ

endif
```
